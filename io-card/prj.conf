## CMakeLists.txt
```
cmake_minimum_required(VERSION 3.20.0)

# Flash with OpenOCD; the board default is STM32CubeProgrammer.
set(BOARD_FLASH_RUNNER openocd)

find_package(Zephyr REQUIRED HINTS $ENV{ZEPHYR_BASE})
project(rc_io_card)

target_include_directories(app PRIVATE ../common/include src)
target_sources(app PRIVATE
  src/main.c
  src/arbiter.c
  src/leds.c
  src/io_bit.c
  src/mode.c
  ../common/proto.c
)
```

## prj.conf
```kconfig
CONFIG_GPIO=y
CONFIG_SERIAL=y
CONFIG_UART_INTERRUPT_DRIVEN=y
CONFIG_RING_BUFFER=y
CONFIG_WATCHDOG=y
CONFIG_LOG=y
CONFIG_SENSOR=y
CONFIG_HWINFO=y
CONFIG_MAIN_STACK_SIZE=2048
```

## src/main.c
```c
#include <zephyr/device.h>
#include <zephyr/drivers/gpio.h>
#include <zephyr/drivers/hwinfo.h>
#include <zephyr/drivers/uart.h>
#include <zephyr/drivers/watchdog.h>
#include <zephyr/kernel.h>
#include <zephyr/logging/log.h>
#include <zephyr/sys/ring_buffer.h>

#include "arbiter.h"
#include "io_bit.h"
#include "leds.h"
#include "mode.h"
#include "rc/proto.h"

LOG_MODULE_REGISTER(io_card, LOG_LEVEL_INF);

#define WDT_TIMEOUT_MS 250U
#define RX_BUF_SIZE 256U
#define IO_BIT_PERIOD_MS 1000
/* Loopback jumper: PD12 (output) to PD13 (input). */
#define LOOP_OUT_PIN 12
#define LOOP_IN_PIN 13

struct link {
	const struct device *dev;
	uint8_t slot;
	struct ring_buf rb;
	uint8_t rb_mem[RX_BUF_SIZE];
	struct rc_parser parser;
	uint32_t rx_dropped;
	uint32_t outputs_rejected;
	uint32_t errors_at_check;
};

static struct link links[2] = {
	{.dev = DEVICE_DT_GET(DT_NODELABEL(usart2)), .slot = RC_SLOT_A},
	{.dev = DEVICE_DT_GET(DT_NODELABEL(uart4)), .slot = RC_SLOT_B},
};

static const struct device *const wdt = DEVICE_DT_GET(DT_ALIAS(watchdog0));
static struct arbiter arb;
static uint8_t applied_mask;
static const struct gpio_dt_spec button = GPIO_DT_SPEC_GET(DT_ALIAS(sw0), gpios);
static const struct device *const gpiod = DEVICE_DT_GET(DT_NODELABEL(gpiod));
static const struct device *const accel = DEVICE_DT_GET(DT_NODELABEL(lsm303agr_accel));
static const struct device *const magn = DEVICE_DT_GET(DT_NODELABEL(lsm303agr_magn));
static struct mode_state mode;
static uint8_t io_fail;
static bool watchdog_reset;
static bool bit_requested;
static uint16_t boot_id;

static char slot_name(uint8_t slot)
{
	return (slot == RC_SLOT_A) ? 'A' : ((slot == RC_SLOT_B) ? 'B' : '-');
}

static void uart_isr(const struct device *dev, void *user_data)
{
	struct link *l = user_data;

	if (uart_irq_update(dev) == 0) {
		return;
	}
	while (uart_irq_rx_ready(dev) != 0) {
		uint8_t buf[16];
		int n = uart_fifo_read(dev, buf, sizeof(buf));
		uint32_t put;

		if (n <= 0) {
			break;
		}
		put = ring_buf_put(&l->rb, buf, (uint32_t)n);
		l->rx_dropped += (uint32_t)n - put;
	}
}

static void send_frame(const struct device *dev, const uint8_t *buf, size_t n)
{
	for (size_t i = 0; i < n; i++) {
		uart_poll_out(dev, buf[i]);
	}
}

static void set_outputs(uint8_t mask)
{
	int err;

	if (mask == applied_mask) {
		return;
	}
	err = leds_set_mask(mask);
	if (err != 0) {
		LOG_ERR("LED update failed: %d", err);
		return;
	}
	applied_mask = mask;
}

static void handle_frame(struct link *l, const struct rc_frame *f, int64_t now)
{
	struct rc_heartbeat hb;
	struct rc_set_outputs so;

	if (rc_decode_heartbeat(f, &hb) == 0) {
		struct rc_status st;
		uint8_t out[RC_FRAME_MAX];
		size_t n;

		if (boot_id == 0U) {
			/* No RNG on this chip: the cycle count at the first heartbeat differs per start. */
			uint32_t c = k_cycle_get_32();

			boot_id = (uint16_t)(c ^ (c >> 16));
			if (boot_id == 0U) {
				boot_id = 1U;
			}
			LOG_INF("t=%lld boot_id=0x%04x", now, boot_id);
		}

		arb_on_heartbeat(&arb, l->slot, hb.role, hb.healthy != 0U, now);
		st.seq = hb.seq;
		st.slot = l->slot;
		st.granted_role = arb_granted_role(&arb, l->slot);
		st.active_slot = arb_active(&arb);
		st.mode = mode.mode;
		st.io_fail = io_fail;
		st.io_time_ms = (uint32_t)now;
		st.io_boot_id = boot_id;
		n = rc_encode_status(&st, out, sizeof(out));
		send_frame(l->dev, out, n);
	} else if (rc_decode_set_outputs(f, &so) == 0) {
		if (arb_accepts_outputs(&arb, l->slot)) {
			set_outputs(so.mask);
		} else {
			l->outputs_rejected++;
		}
	} else if (rc_decode_run_bit(f) == 0) {
		if (arb_accepts_outputs(&arb, l->slot)) {
			bit_requested = true;
		} else {
			LOG_WRN("slot %c: RUN_BIT ignored, not Active", slot_name(l->slot));
		}
	} else {
		LOG_WRN("slot %c: unexpected frame type %u len %u", slot_name(l->slot), f->type,
			f->len);
	}
}

/* Drives the loopback output and reads the input: 1, 0, or a negative error. */
static int loop_read(int level)
{
	int err = gpio_pin_set(gpiod, LOOP_OUT_PIN, level);

	if (err != 0) {
		return err;
	}
	k_busy_wait(20);
	return gpio_pin_get(gpiod, LOOP_IN_PIN);
}

static void bit_run(int64_t now, bool pbit)
{
	struct io_bit_input in = {0};
	int led = leds_get_mask();
	uint8_t fail;

	in.loop_high = (loop_read(1) == 1);
	in.loop_low = (loop_read(0) != 0);
	in.led_read = (led < 0) ? (uint8_t)~applied_mask : (uint8_t)led;
	in.led_applied = applied_mask;
	in.accel_ready = device_is_ready(accel);
	in.magn_ready = device_is_ready(magn);
	for (size_t i = 0; i < ARRAY_SIZE(links); i++) {
		struct link *l = &links[i];
		uint32_t total = l->parser.crc_errors + l->parser.len_errors;

		in.uart_errors[i] = total - l->errors_at_check;
		l->errors_at_check = total;
	}
	in.watchdog_reset = watchdog_reset;
	fail = io_bit_eval(&in);
	if (pbit) {
		LOG_INF("t=%lld io_bit: pbit fail=0x%02x", now, fail);
	} else if (fail != io_fail) {
		LOG_INF("t=%lld io_bit: fail=0x%02x", now, fail);
	}
	io_fail = fail;
}

static int io_init(void)
{
	uint32_t cause;
	int err;

	if (!gpio_is_ready_dt(&button) || !device_is_ready(gpiod)) {
		return -ENODEV;
	}
	err = gpio_pin_configure_dt(&button, GPIO_INPUT);
	if (err == 0) {
		err = gpio_pin_configure(gpiod, LOOP_OUT_PIN, GPIO_OUTPUT_INACTIVE);
	}
	if (err == 0) {
		err = gpio_pin_configure(gpiod, LOOP_IN_PIN, GPIO_INPUT | GPIO_PULL_DOWN);
	}
	if (err != 0) {
		return err;
	}
	err = hwinfo_get_reset_cause(&cause);
	if (err != 0) {
		LOG_ERR("reset cause unavailable: %d", err);
	} else {
		watchdog_reset = (cause & RESET_WATCHDOG) != 0U;
		err = hwinfo_clear_reset_cause();
		if (err != 0) {
			LOG_ERR("reset cause clear failed: %d", err);
		}
	}
	mode_init(&mode, gpio_pin_get_dt(&button) == 1, k_uptime_get());
	return 0;
}

static int links_init(void)
{
	for (size_t i = 0; i < ARRAY_SIZE(links); i++) {
		struct link *l = &links[i];
		int err;

		if (!device_is_ready(l->dev)) {
			return -ENODEV;
		}
		ring_buf_init(&l->rb, sizeof(l->rb_mem), l->rb_mem);
		rc_parser_init(&l->parser);
		err = uart_irq_callback_user_data_set(l->dev, uart_isr, l);
		if (err != 0) {
			return err;
		}
		uart_irq_rx_enable(l->dev);
	}
	return 0;
}

static int wdt_start(void)
{
	struct wdt_timeout_cfg cfg = {
		.window = {.min = 0U, .max = WDT_TIMEOUT_MS},
		.callback = NULL,
		.flags = WDT_FLAG_RESET_SOC,
	};
	int ch;
	int err;

	if (!device_is_ready(wdt)) {
		return -ENODEV;
	}
	ch = wdt_install_timeout(wdt, &cfg);
	if (ch < 0) {
		return ch;
	}
	err = wdt_setup(wdt, WDT_OPT_PAUSE_HALTED_BY_DBG);
	if (err != 0) {
		return err;
	}
	return ch;
}

int main(void)
{
	int64_t last_bit;
	bool button_error = false;
	int wdt_ch;
	int err;

	err = leds_init();
	if (err != 0) {
		LOG_ERR("LEDs not ready: %d", err);
		return 0;
	}
	err = links_init();
	if (err != 0) {
		LOG_ERR("UART links not ready: %d", err);
		return 0;
	}
	err = io_init();
	if (err != 0) {
		LOG_ERR("button or loopback pins not ready: %d", err);
		return 0;
	}
	wdt_ch = wdt_start();
	if (wdt_ch < 0) {
		LOG_ERR("watchdog start failed: %d", wdt_ch);
		return 0;
	}
	arb_init(&arb);
	LOG_INF("io-card ready: A=USART2 PA2/PA3, B=UART4 PC10/PC11, loopback PD12->PD13");
	last_bit = k_uptime_get();
	bit_run(last_bit, true);

	for (;;) {
		int64_t now = k_uptime_get();
		uint8_t before = arb_active(&arb);
		int b;

		for (size_t i = 0; i < ARRAY_SIZE(links); i++) {
			struct link *l = &links[i];
			uint8_t byte;

			while (ring_buf_get(&l->rb, &byte, 1U) == 1U) {
				struct rc_frame f;

				if (!rc_parser_feed(&l->parser, byte, &f)) {
					continue;
				}
				do {
					handle_frame(l, &f, now);
				} while (rc_parser_next(&l->parser, &f));
			}
		}
		if (arb_tick(&arb, now)) {
			uint8_t after = arb_active(&arb);
			int64_t gap = (before != RC_SLOT_NONE) ? now - arb_last_rx_ms(&arb, before)
							       : -1;

			LOG_INF("t=%lld active: %c -> %c gap_ms=%lld", now, slot_name(before),
				slot_name(after), gap);
		}
		if (arb_active(&arb) == RC_SLOT_NONE) {
			set_outputs(0U);
		}
		b = gpio_pin_get_dt(&button);
		if (b < 0) {
			if (!button_error) {
				LOG_ERR("button read failed: %d", b);
				button_error = true;
			}
		} else {
			button_error = false;
			if (mode_on_sample(&mode, b == 1, now)) {
				LOG_INF("t=%lld mode: %s", now,
					(mode.mode == RC_MODE_TEST) ? "test" : "operational");
			}
		}
		if (bit_requested || ((now - last_bit) >= IO_BIT_PERIOD_MS)) {
			bit_run(now, false);
			last_bit = now;
			bit_requested = false;
		}
		err = wdt_feed(wdt, wdt_ch);
		if (err != 0) {
			LOG_ERR("watchdog feed failed: %d", err);
		}
		k_msleep(1);
	}
	return 0;
}
```

## src/arbiter.c
```c
#include <string.h>

#include "arbiter.h"

static bool valid_slot(uint8_t slot)
{
	return (slot == RC_SLOT_A) || (slot == RC_SLOT_B);
}

static uint8_t other(uint8_t slot)
{
	return (slot == RC_SLOT_A) ? RC_SLOT_B : RC_SLOT_A;
}

void arb_init(struct arbiter *a)
{
	memset(a, 0, sizeof(*a));
	a->active = RC_SLOT_NONE;
}

void arb_on_heartbeat(struct arbiter *a, uint8_t slot, uint8_t reported_role, bool healthy,
		      int64_t now_ms)
{
	if (!valid_slot(slot)) {
		return;
	}
	a->slot[slot].heard = true;
	a->slot[slot].last_rx_ms = now_ms;
	a->slot[slot].reported_role = reported_role;
	a->slot[slot].healthy = healthy;
}

bool arb_present(const struct arbiter *a, uint8_t slot, int64_t now_ms)
{
	if (!valid_slot(slot)) {
		return false;
	}
	return a->slot[slot].heard && ((now_ms - a->slot[slot].last_rx_ms) <= ARB_HB_TIMEOUT_MS);
}

static bool healthy(const struct arbiter *a, uint8_t slot, int64_t now_ms)
{
	return arb_present(a, slot, now_ms) && a->slot[slot].healthy;
}

static bool claims_active(const struct arbiter *a, uint8_t slot)
{
	return a->slot[slot].reported_role == RC_ROLE_ACTIVE;
}

static uint8_t elect(const struct arbiter *a, int64_t now_ms)
{
	static const uint8_t order[2] = {RC_SLOT_A, RC_SLOT_B};

	for (int i = 0; i < 2; i++) {
		if (healthy(a, order[i], now_ms) && claims_active(a, order[i])) {
			return order[i];
		}
	}
	for (int i = 0; i < 2; i++) {
		if (healthy(a, order[i], now_ms)) {
			return order[i];
		}
	}
	for (int i = 0; i < 2; i++) {
		if (arb_present(a, order[i], now_ms) && claims_active(a, order[i])) {
			return order[i];
		}
	}
	for (int i = 0; i < 2; i++) {
		if (arb_present(a, order[i], now_ms)) {
			return order[i];
		}
	}
	return RC_SLOT_NONE;
}

bool arb_tick(struct arbiter *a, int64_t now_ms)
{
	uint8_t before = a->active;

	if (a->active != RC_SLOT_NONE) {
		uint8_t o = other(a->active);

		if (!arb_present(a, a->active, now_ms)) {
			a->active = arb_present(a, o, now_ms) ? o : RC_SLOT_NONE;
			a->handover_pending = false;
		} else if (!a->slot[a->active].healthy && healthy(a, o, now_ms)) {
			if (!a->handover_pending) {
				a->handover_pending = true;
				a->handover_since_ms = now_ms;
			} else if ((now_ms - a->handover_since_ms) >= ARB_HEALTH_HOLD_MS) {
				a->active = o;
				a->handover_pending = false;
			}
		} else {
			a->handover_pending = false;
		}
	} else if (!a->electing) {
		if (arb_present(a, RC_SLOT_A, now_ms) || arb_present(a, RC_SLOT_B, now_ms)) {
			a->electing = true;
			a->election_start_ms = now_ms;
		}
	} else if ((now_ms - a->election_start_ms) >= ARB_ELECTION_WINDOW_MS) {
		a->electing = false;
		a->active = elect(a, now_ms);
	}
	return a->active != before;
}

uint8_t arb_active(const struct arbiter *a)
{
	return a->active;
}

uint8_t arb_granted_role(const struct arbiter *a, uint8_t slot)
{
	if (!valid_slot(slot) || (a->active == RC_SLOT_NONE)) {
		return RC_ROLE_UNKNOWN;
	}
	return (slot == a->active) ? RC_ROLE_ACTIVE : RC_ROLE_STANDBY;
}

bool arb_accepts_outputs(const struct arbiter *a, uint8_t slot)
{
	return valid_slot(slot) && (slot == a->active);
}

int64_t arb_last_rx_ms(const struct arbiter *a, uint8_t slot)
{
	return valid_slot(slot) ? a->slot[slot].last_rx_ms : -1;
}
```

## src/arbiter.h
```c
#ifndef ARBITER_H_
#define ARBITER_H_

#include <stdbool.h>
#include <stdint.h>

#include "rc/proto.h"

#define ARB_HB_TIMEOUT_MS 100
#define ARB_ELECTION_WINDOW_MS 1500
/* An unhealthy Active hands over only after the condition holds this long. */
#define ARB_HEALTH_HOLD_MS 1200

struct arb_slot {
	bool heard;
	int64_t last_rx_ms;
	uint8_t reported_role;
	bool healthy;
};

struct arbiter {
	struct arb_slot slot[2];
	uint8_t active;
	bool electing;
	int64_t election_start_ms;
	bool handover_pending;
	int64_t handover_since_ms;
};

void arb_init(struct arbiter *a);
void arb_on_heartbeat(struct arbiter *a, uint8_t slot, uint8_t reported_role, bool healthy,
		      int64_t now_ms);

/* Updates presence and the Active slot; returns true when the Active slot changed. */
bool arb_tick(struct arbiter *a, int64_t now_ms);

bool arb_present(const struct arbiter *a, uint8_t slot, int64_t now_ms);
uint8_t arb_active(const struct arbiter *a);

/* RC_ROLE_UNKNOWN while no slot is Active (election pending or nobody present). */
uint8_t arb_granted_role(const struct arbiter *a, uint8_t slot);

bool arb_accepts_outputs(const struct arbiter *a, uint8_t slot);
int64_t arb_last_rx_ms(const struct arbiter *a, uint8_t slot);

#endif /* ARBITER_H_ */
```

## src/io_bit.c
```c
#include "io_bit.h"

uint8_t io_bit_eval(const struct io_bit_input *in)
{
	uint8_t fail = 0U;

	if (!in->loop_high || in->loop_low) {
		fail |= IO_BIT_LOOPBACK;
	}
	if (in->led_read != in->led_applied) {
		fail |= IO_BIT_LEDS;
	}
	if (!in->accel_ready || !in->magn_ready) {
		fail |= IO_BIT_SENSORS;
	}
	if (in->uart_errors[0] >= IO_BIT_UART_ERROR_LIMIT) {
		fail |= IO_BIT_UART_A;
	}
	if (in->uart_errors[1] >= IO_BIT_UART_ERROR_LIMIT) {
		fail |= IO_BIT_UART_B;
	}
	if (in->watchdog_reset) {
		fail |= IO_BIT_RESET;
	}
	return fail;
}
```

## src/io_bit.h
```c
#ifndef IO_BIT_H_
#define IO_BIT_H_

#include <stdbool.h>
#include <stdint.h>

#define IO_BIT_LOOPBACK (1U << 0)
#define IO_BIT_LEDS (1U << 1)
#define IO_BIT_SENSORS (1U << 2)
#define IO_BIT_UART_A (1U << 3)
#define IO_BIT_UART_B (1U << 4)
#define IO_BIT_RESET (1U << 5)

/* A slot fails at this many CRC or length errors in one check period. */
#define IO_BIT_UART_ERROR_LIMIT 5U

struct io_bit_input {
	bool loop_high; /* loopback input read while the output drives high */
	bool loop_low;  /* loopback input read while the output drives low */
	uint8_t led_read;
	uint8_t led_applied;
	bool accel_ready;
	bool magn_ready;
	uint32_t uart_errors[2]; /* errors since the last check, per slot */
	bool watchdog_reset;
};

/* Returns the fail mask (IO_BIT_* bits). */
uint8_t io_bit_eval(const struct io_bit_input *in);

#endif /* IO_BIT_H_ */
```

## src/leds.c
```c
#include <errno.h>
#include <zephyr/drivers/gpio.h>

#include "leds.h"

static const struct gpio_dt_spec ring[8] = {
	GPIO_DT_SPEC_GET(DT_NODELABEL(red_led_3), gpios),    /* N  LD3  */
	GPIO_DT_SPEC_GET(DT_NODELABEL(orange_led_5), gpios), /* NE LD5  */
	GPIO_DT_SPEC_GET(DT_NODELABEL(green_led_7), gpios),  /* E  LD7  */
	GPIO_DT_SPEC_GET(DT_NODELABEL(blue_led_9), gpios),   /* SE LD9  */
	GPIO_DT_SPEC_GET(DT_NODELABEL(red_led_10), gpios),   /* S  LD10 */
	GPIO_DT_SPEC_GET(DT_NODELABEL(orange_led_8), gpios), /* SW LD8  */
	GPIO_DT_SPEC_GET(DT_NODELABEL(green_led_6), gpios),  /* W  LD6  */
	GPIO_DT_SPEC_GET(DT_NODELABEL(blue_led_4), gpios),   /* NW LD4  */
};

int leds_init(void)
{
	for (int i = 0; i < 8; i++) {
		int err;

		if (!gpio_is_ready_dt(&ring[i])) {
			return -ENODEV;
		}
		err = gpio_pin_configure_dt(&ring[i], GPIO_OUTPUT_INACTIVE);
		if (err != 0) {
			return err;
		}
	}
	return 0;
}

int leds_set_mask(uint8_t mask)
{
	for (int i = 0; i < 8; i++) {
		int err = gpio_pin_set_dt(&ring[i], (int)((mask >> i) & 1U));

		if (err != 0) {
			return err;
		}
	}
	return 0;
}

int leds_get_mask(void)
{
	int mask = 0;

	for (int i = 0; i < 8; i++) {
		int v = gpio_pin_get_dt(&ring[i]);

		if (v < 0) {
			return v;
		}
		mask |= (v & 1) << i;
	}
	return mask;
}
```

## src/leds.h
```c
#ifndef LEDS_H_
#define LEDS_H_

#include <stdint.h>

int leds_init(void);

/* Bit i lights ring position i (0 = N, clockwise). */
int leds_set_mask(uint8_t mask);

/* Reads the ring back from the pins; returns the mask or a negative error. */
int leds_get_mask(void);

#endif /* LEDS_H_ */
```

## src/mode.c
```c
#include "mode.h"

void mode_init(struct mode_state *m, bool pressed, int64_t now_ms)
{
	m->mode = RC_MODE_OPERATIONAL;
	m->stable = pressed;
	m->raw = pressed;
	m->raw_since_ms = now_ms;
}

bool mode_on_sample(struct mode_state *m, bool pressed, int64_t now_ms)
{
	if (pressed != m->raw) {
		m->raw = pressed;
		m->raw_since_ms = now_ms;
		return false;
	}
	if ((pressed == m->stable) || ((now_ms - m->raw_since_ms) < MODE_DEBOUNCE_MS)) {
		return false;
	}
	m->stable = pressed;
	if (!pressed) {
		return false;
	}
	m->mode = (m->mode == RC_MODE_TEST) ? RC_MODE_OPERATIONAL : RC_MODE_TEST;
	return true;
}
```

## src/mode.h
```c
#ifndef MODE_H_
#define MODE_H_

#include <stdbool.h>
#include <stdint.h>

#include "rc/proto.h"

#define MODE_DEBOUNCE_MS 50

struct mode_state {
	uint8_t mode;
	bool stable;
	bool raw;
	int64_t raw_since_ms;
};

void mode_init(struct mode_state *m, bool pressed, int64_t now_ms);

/* Feeds one button sample; returns true when a debounced press toggled the mode. */
bool mode_on_sample(struct mode_state *m, bool pressed, int64_t now_ms);

#endif /* MODE_H_ */
```
